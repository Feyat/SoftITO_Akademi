# file: 429_RNG_Project.ioc
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Mcu.Family=STM32F4
Mcu.Name=STM32F429ZITx
Mcu.Package=LQFP144
NVIC.PriorityGroup=NVIC_PRIORITYGROUP_4
ProjectManager.HeapSize=0x200
ProjectManager.StackSize=0x400
ProjectManager.TargetToolchain=STM32CubeIDE
RCC.AHBFreq_Value=16000000
RCC.APB1Freq_Value=16000000
RCC.APB2Freq_Value=16000000
RCC.CortexFreq_Value=16000000
RCC.HSE_VALUE=25000000
RCC.HSI_VALUE=16000000
RCC.LSE_VALUE=32768
RCC.SYSCLKFreq_VALUE=16000000
RCC.VCOOutputFreq_Value=192000000
VP_RNG_VS_RNG.Mode=RNG_Activate
board=custom

// file: Core/Src/main.c
/* USER CODE BEGIN Header */
/**
  ******************************************************************************
  * @file           : main.c
  * @brief          : Main program body
  ******************************************************************************
  * @attention
  *
  * Copyright (c) 2025 STMicroelectronics.
  * All rights reserved.
  *
  * This software is licensed under terms that can be found in the LICENSE file
  * in the root directory of this software component.
  * If no LICENSE file comes with this software, it is provided AS-IS.
  *
  ******************************************************************************
  */
/* USER CODE END Header */
#include "main.h"

RNG_HandleTypeDef hrng;

void SystemClock_Config(void);
static void MX_RNG_Init(void);

EXTI_HandleTypeDef    hexti0;
EXTI_HandleTypeDef    hexti1;

int dizi[4] = {GPIO_PIN_5, GPIO_PIN_6, GPIO_PIN_7, GPIO_PIN_8};

void EXTI_CALLBACK_SET(void){
	hrng.Instance = RNG;
	HAL_RNG_Init(&hrng);
	uint32_t random;
	HAL_RNG_GenerateRandomNumber(&hrng, &random);
	HAL_GPIO_WritePin(GPIOG, dizi[random%4], GPIO_PIN_SET);
}

void EXTI_CALLBACK_RESET(void){
	hrng.Instance = RNG;
	HAL_RNG_Init(&hrng);
	uint32_t random;
	HAL_RNG_GenerateRandomNumber(&hrng, &random);
	HAL_GPIO_WritePin(GPIOG, dizi[random%4], GPIO_PIN_RESET);
}

void EXTI0_IRQHandler(void){
	HAL_EXTI_IRQHandler(&hexti0);
}

void EXTI2_IRQHandler(void){
	HAL_EXTI_IRQHandler(&hexti1);
}

int main(void)
{

  /* MCU Configuration--------------------------------------------------------*/

  /* Reset of all peripherals, Initializes the Flash interface and the Systick. */
  HAL_Init();

  /* USER CODE BEGIN Init */

  __HAL_RCC_GPIOA_CLK_ENABLE();
  __HAL_RCC_GPIOG_CLK_ENABLE();
  __HAL_RCC_RNG_CLK_ENABLE();
  __HAL_RCC_SYSCFG_CLK_ENABLE();

  GPIO_InitTypeDef gpio_init;
  gpio_init.Pin = GPIO_PIN_5 | GPIO_PIN_6 | GPIO_PIN_7 | GPIO_PIN_8;
  gpio_init.Mode = GPIO_MODE_OUTPUT_PP ;
  gpio_init.Pull = GPIO_PULLDOWN;
  HAL_GPIO_Init(GPIOG, &gpio_init);

  GPIO_InitTypeDef gpioO_init;
  gpioO_init.Pin = GPIO_PIN_0 | GPIO_PIN_2;
  gpioO_init.Mode = GPIO_MODE_INPUT;
  gpioO_init.Pull =GPIO_PULLUP;
  HAL_GPIO_Init(GPIOA, &gpioO_init);

  EXTI_ConfigTypeDef exti_config_one;
  EXTI_ConfigTypeDef exti_config_zero;

  NVIC_EnableIRQ(EXTI0_IRQn);
  NVIC_EnableIRQ(EXTI1_IRQn);

  NVIC_SetPriority(EXTI0_IRQn, 0);
  NVIC_SetPriority(EXTI1_IRQn, 1);

  exti_config_zero.Line = EXTI_LINE_0 ;
  exti_config_zero.Mode = EXTI_MODE_INTERRUPT;
  exti_config_zero.Trigger = EXTI_TRIGGER_RISING;
  exti_config_zero.GPIOSel = EXTI_GPIOA;

  exti_config_one.Line = EXTI_LINE_2 ;
  exti_config_one.Mode = EXTI_MODE_INTERRUPT;
  exti_config_one.Trigger = EXTI_TRIGGER_RISING;
  exti_config_one.GPIOSel = EXTI_GPIOA;

  hexti0.Line =  EXTI_LINE_0;
  hexti1.Line = EXTI_LINE_2;

  HAL_EXTI_SetConfigLine(&hexti0, &exti_config_zero);
  HAL_EXTI_SetConfigLine(&hexti1, &exti_config_one);
  HAL_EXTI_RegisterCallback(&hexti0, HAL_EXTI_COMMON_CB_ID, EXTI_CALLBACK_SET);
  HAL_EXTI_RegisterCallback(&hexti1, HAL_EXTI_COMMON_CB_ID, EXTI_CALLBACK_RESET);

  /* USER CODE END Init */

  /* Configure the system clock */
  SystemClock_Config();

  /* Initialize all configured peripherals */
  MX_RNG_Init();

  /* Infinite loop */
  while (1)
  {

  }
}

void SystemClock_Config(void)
{
  RCC_OscInitTypeDef RCC_OscInitStruct = {0};
  RCC_ClkInitTypeDef RCC_ClkInitStruct = {0};

  /** Configure the main internal regulator output voltage
  */
  __HAL_RCC_PWR_CLK_ENABLE();
  __HAL_PWR_VOLTAGESCALING_CONFIG(PWR_REGULATOR_VOLTAGE_SCALE3);

  /** Initializes the RCC Oscillators according to the specified parameters
  * in the RCC_OscInitTypeDef structure.
  */
  RCC_OscInitStruct.OscillatorType = RCC_OSCILLATORTYPE_HSI;
  RCC_OscInitStruct.HSIState = RCC_HSI_ON;
  RCC_OscInitStruct.HSICalibrationValue = RCC_HSICALIBRATION_DEFAULT;
  RCC_OscInitStruct.PLL.PLLState = RCC_PLL_ON;
  RCC_OscInitStruct.PLL.PLLSource = RCC_PLLSOURCE_HSI;
  RCC_OscInitStruct.PLL.PLLM = 16;
  RCC_OscInitStruct.PLL.PLLN = 192;
  RCC_OscInitStruct.PLL.PLLP = RCC_PLLP_DIV2;
  RCC_OscInitStruct.PLL.PLLQ = 4;
  if (HAL_RCC_OscConfig(&RCC_OscInitStruct) != HAL_OK)
  {
    Error_Handler();
  }

  /** Initializes the CPU, AHB and APB buses clocks
  */
  RCC_ClkInitStruct.ClockType = RCC_CLOCKTYPE_HCLK|RCC_CLOCKTYPE_SYSCLK
                              |RCC_CLOCKTYPE_PCLK1|RCC_CLOCKTYPE_PCLK2;
  RCC_ClkInitStruct.SYSCLKSource = RCC_SYSCLKSOURCE_HSI;
  RCC_ClkInitStruct.AHBCLKDivider = RCC_SYSCLK_DIV1;
  RCC_ClkInitStruct.APB1CLKDivider = RCC_HCLK_DIV1;
  RCC_ClkInitStruct.APB2CLKDivider = RCC_HCLK_DIV1;

  if (HAL_RCC_ClockConfig(&RCC_ClkInitStruct, FLASH_LATENCY_0) != HAL_OK)
  {
    Error_Handler();
  }
}

static void MX_RNG_Init(void)
{

  hrng.Instance = RNG;
  if (HAL_RNG_Init(&hrng) != HAL_OK)
  {
    Error_Handler();
  }

}

void Error_Handler(void)
{
  __disable_irq();
  while (1)
  {
  }
}
