# file: dht11_data.ioc
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Mcu.Family=STM32F4
Mcu.Name=STM32F429ZITx
Mcu.Package=LQFP144
NVIC.PriorityGroup=NVIC_PRIORITYGROUP_4
NVIC.TIM6_DAC_IRQn=true\:0\:0\:false\:false\:true\:true\:true\:true
ProjectManager.HeapSize=0x200
ProjectManager.StackSize=0x400
ProjectManager.TargetToolchain=STM32CubeIDE
RCC.AHBFreq_Value=16000000
RCC.APB1Freq_Value=16000000
RCC.APB2Freq_Value=16000000
RCC.CortexFreq_Value=16000000
RCC.HSE_VALUE=25000000
RCC.HSI_VALUE=16000000
RCC.LSE_VALUE=32768
RCC.SYSCLKFreq_VALUE=16000000
RCC.VCOOutputFreq_Value=192000000
TIM6.Prescaler=15
VP_TIM6_VS_ClockSourceINT.Mode=Enable_Timer
board=custom

// file: Core/Src/main.c
/* USER CODE BEGIN Header */
/**
  ******************************************************************************
  * @file           : main.c
  * @brief          : Main program body
  ******************************************************************************
  * @attention
  *
  * Copyright (c) 2025 STMicroelectronics.
  * All rights reserved.
  *
  * This software is licensed under terms that can be found in the LICENSE file
  * in the root directory of this software component.
  * If no LICENSE file comes with this software, it is provided AS-IS.
  *
  ******************************************************************************
  */
/* USER CODE END Header */
#include "main.h"

TIM_HandleTypeDef htim6;

void SystemClock_Config(void);
static void MX_TIM6_Init(void);

/* USER CODE BEGIN 0 */

//micro saniye cinsinden bir timer
void delay(uint16_t time) {
__HAL_TIM_SET_COUNTER(&htim6, 0);
while(__HAL_TIM_GET_COUNTER(&htim6) < time);
}

void Input(){
	  GPIO_InitTypeDef GPIO_InitStruct;

	  GPIO_InitStruct.Pin = GPIO_PIN_4;
	  GPIO_InitStruct.Mode = GPIO_MODE_INPUT;
	  GPIO_InitStruct.Pull = GPIO_PULLDOWN;
	  HAL_GPIO_Init(GPIOC, &GPIO_InitStruct);

}

void Output() {

	 GPIO_InitTypeDef GPIO_InitStruct;

     GPIO_InitStruct.Pin = GPIO_PIN_4;
	 GPIO_InitStruct.Mode = GPIO_MODE_OUTPUT_PP;
	 GPIO_InitStruct.Pull = GPIO_PULLDOWN;
     HAL_GPIO_Init(GPIOC, &GPIO_InitStruct);

}

uint8_t bit, bit1, bit2, bit3, bit4;

void DHT11_Init(){

	Input();

	HAL_Delay(20);

	Output();

	HAL_Delay(20);

	Input();
	//delay(200);

	while(HAL_GPIO_ReadPin(GPIOC, GPIO_PIN_4) == 1);

	while(HAL_GPIO_ReadPin(GPIOC, GPIO_PIN_4) == 0);

	while(HAL_GPIO_ReadPin(GPIOC, GPIO_PIN_4) == 1);

	// start transmisson

	while(HAL_GPIO_ReadPin(GPIOC, GPIO_PIN_4) == 0);
	// ilk bit

	__HAL_TIM_SET_COUNTER(&htim6, 0);

	while(HAL_GPIO_ReadPin(GPIOC, GPIO_PIN_4) == 1);

	uint32_t count = __HAL_TIM_GET_COUNTER(&htim6);

	if(count > 20 && count < 30)
		bit = 0;

	else if(count > 65 && count< 72)
		bit = 1;

	while(HAL_GPIO_ReadPin(GPIOC, GPIO_PIN_4) == 0);
	// ikinci bit

	__HAL_TIM_SET_COUNTER(&htim6, 0);

	while(HAL_GPIO_ReadPin(GPIOC, GPIO_PIN_4) == 1);

	count = __HAL_TIM_GET_COUNTER(&htim6);

	if(count > 20 && count < 30)
		bit1 = 0;

	else if(count > 65 && count< 72)
		bit1 = 1;

	while(HAL_GPIO_ReadPin(GPIOC, GPIO_PIN_4) == 0);
	//üçüncü bit

	__HAL_TIM_SET_COUNTER(&htim6, 0);

	while(HAL_GPIO_ReadPin(GPIOC, GPIO_PIN_4) == 1);

	count = __HAL_TIM_GET_COUNTER(&htim6);

	if(count > 20 && count < 30)
		bit2 = 0;

	else if(count > 65 && count< 72)
		bit2 = 1;

	while(HAL_GPIO_ReadPin(GPIOC, GPIO_PIN_4) == 0);
	// dördüncü bit

	__HAL_TIM_SET_COUNTER(&htim6, 0);

	while(HAL_GPIO_ReadPin(GPIOC, GPIO_PIN_4) == 1);

	count = __HAL_TIM_GET_COUNTER(&htim6);

	if(count > 20 && count < 30)
		bit3 = 0;

	else if(count > 65 && count< 72)
		bit3 = 1;

	while(HAL_GPIO_ReadPin(GPIOC, GPIO_PIN_4) == 0);
	// beşinci bit

	__HAL_TIM_SET_COUNTER(&htim6, 0);

	while(HAL_GPIO_ReadPin(GPIOC, GPIO_PIN_4) == 1);

	count = __HAL_TIM_GET_COUNTER(&htim6);

	if(count > 20 && count < 30)
		bit4 = 0;

	else if(count > 65 && count< 72)
		bit4 = 1;

	/*
	uint8_t byte;

	for(uint8_t i=0;i<8;i++){

		while(HAL_GPIO_ReadPin(GPIOC, GPIO_PIN_4) == 0);

		__HAL_TIM_SET_COUNTER(&htim6, 0);

		while(HAL_GPIO_ReadPin(GPIOC, GPIO_PIN_4) == 1);

		uint32_t count = __HAL_TIM_GET_COUNTER(&htim6);

		if(count > 24 && count < 30)
			byte &= ~(1<<(7-i));

		else if(count > 68 && count< 72)
			byte |= (1<<(7-i));
	}
	return byte;
	*/
}

/* USER CODE END 0 */

int main(void)
{

  /* MCU Configuration--------------------------------------------------------*/

  /* Reset of all peripherals, Initializes the Flash interface and the Systick. */
  HAL_Init();

  /* Configure the system clock */
  SystemClock_Config();

  /* Initialize all configured peripherals */
  MX_TIM6_Init();
  /* USER CODE BEGIN 2 */

  __HAL_RCC_GPIOC_CLK_ENABLE();

  HAL_TIM_Base_Start(&htim6);

  DHT11_Init();
  DHT11_Init();
  /* USER CODE END 2 */

  /* Infinite loop */
  while (1)
  {

  }
}

void SystemClock_Config(void)
{
  RCC_OscInitTypeDef RCC_OscInitStruct = {0};
  RCC_ClkInitTypeDef RCC_ClkInitStruct = {0};

  /** Configure the main internal regulator output voltage
  */
  __HAL_RCC_PWR_CLK_ENABLE();
  __HAL_PWR_VOLTAGESCALING_CONFIG(PWR_REGULATOR_VOLTAGE_SCALE3);

  /** Initializes the RCC Oscillators according to the specified parameters
  * in the RCC_OscInitTypeDef structure.
  */
  RCC_OscInitStruct.OscillatorType = RCC_OSCILLATORTYPE_HSI;
  RCC_OscInitStruct.HSIState = RCC_HSI_ON;
  RCC_OscInitStruct.HSICalibrationValue = RCC_HSICALIBRATION_DEFAULT;
  RCC_OscInitStruct.PLL.PLLState = RCC_PLL_NONE;
  if (HAL_RCC_OscConfig(&RCC_OscInitStruct) != HAL_OK)
  {
    Error_Handler();
  }

  /** Initializes the CPU, AHB and APB buses clocks
  */
  RCC_ClkInitStruct.ClockType = RCC_CLOCKTYPE_HCLK|RCC_CLOCKTYPE_SYSCLK
                              |RCC_CLOCKTYPE_PCLK1|RCC_CLOCKTYPE_PCLK2;
  RCC_ClkInitStruct.SYSCLKSource = RCC_SYSCLKSOURCE_HSI;
  RCC_ClkInitStruct.AHBCLKDivider = RCC_SYSCLK_DIV1;
  RCC_ClkInitStruct.APB1CLKDivider = RCC_HCLK_DIV1;
  RCC_ClkInitStruct.APB2CLKDivider = RCC_HCLK_DIV1;

  if (HAL_RCC_ClockConfig(&RCC_ClkInitStruct, FLASH_LATENCY_0) != HAL_OK)
  {
    Error_Handler();
  }
}

static void MX_TIM6_Init(void)
{

  TIM_MasterConfigTypeDef sMasterConfig = {0};

  htim6.Instance = TIM6;
  htim6.Init.Prescaler = 15;
  htim6.Init.CounterMode = TIM_COUNTERMODE_UP;
  htim6.Init.Period = 65535;
  htim6.Init.AutoReloadPreload = TIM_AUTORELOAD_PRELOAD_DISABLE;
  if (HAL_TIM_Base_Init(&htim6) != HAL_OK)
  {
    Error_Handler();
  }
  sMasterConfig.MasterOutputTrigger = TIM_TRGO_RESET;
  sMasterConfig.MasterSlaveMode = TIM_MASTERSLAVEMODE_DISABLE;
  if (HAL_TIMEx_MasterConfigSynchronization(&htim6, &sMasterConfig) != HAL_OK)
  {
    Error_Handler();
  }

}

void Error_Handler(void)
{
  __disable_irq();
  while (1)
  {
  }
}
